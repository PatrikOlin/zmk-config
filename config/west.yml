## config/west.yml
```yaml
manifest:
  remotes:
    - name: zmkfirmware
      url-base: https://github.com/zmkfirmware
    - name: aurora-sweep
      url-base: https://github.com/petejohanson/zmk.git
  projects:
    - name: zmk
      remote: aurora-sweep
      revision: shields/splitkb_aurora_sweep
      import: app/west.yml
  self:
    path: config
```
